/dts-v1/;
/plugin/;

/ {
	compatible = "bcm2711"; // raspberry pi 4B

	fragment@0 {
		target = <&i2c_arm>;

		__overlay__ {
			status = "okay";

			// SHT20 define
			sht20: sht20 {
				compatible = "jmw,sht20"; // device name

				reg = <0x40>; // i2c device address
				status = "okay";
			};
		};
	};
};
