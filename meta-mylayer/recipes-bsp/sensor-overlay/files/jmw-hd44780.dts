/dts-v1/;
/plugin/;

/ {
	compatible = "bcm2711";

	fragment@0 {
		target = <&i2c_arm>;

		__overlay__ {
			status = "okay";

			hd44780: hd44780@27d
			{
				compatible = "jmw,hd44780";

				reg = <0x27>; // 디바이스 주소
				status = "okay";
			};
		};
	};
};
