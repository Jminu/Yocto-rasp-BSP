## build/conf/bblayers.conf
```bitbake
# POKY_BBLAYERS_CONF_VERSION is increased each time build/conf/bblayers.conf
# changes incompatibly
POKY_BBLAYERS_CONF_VERSION = "2"

BBPATH = "${TOPDIR}"
BBFILES ?= ""

BBLAYERS ?= " \
  /home/jinminu/projects/Yocto-rasp-BSP/poky/meta \
  /home/jinminu/projects/Yocto-rasp-BSP/poky/meta-poky \
  /home/jinminu/projects/Yocto-rasp-BSP/poky/meta-yocto-bsp \
  /home/jinminu/projects/Yocto-rasp-BSP/meta-raspberrypi \
  /home/jinminu/projects/Yocto-rasp-BSP/meta-openembedded/meta-oe \
  /home/jinminu/projects/Yocto-rasp-BSP/meta-openembedded/meta-multimedia \
  /home/jinminu/projects/Yocto-rasp-BSP/meta-openembedded/meta-networking \
  /home/jinminu/projects/Yocto-rasp-BSP/meta-openembedded/meta-python \
  /home/jinminu/projects/Yocto-rasp-BSP/meta-mylayer \
"
```
